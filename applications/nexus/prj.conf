## CMakeLists.txt
```
# SPDX-License-Identifier: Apache-2.0

cmake_minimum_required(VERSION 3.20.0)
find_package(Zephyr REQUIRED HINTS $ENV{ZEPHYR_BASE})

project(nexus)

target_sources(app PRIVATE src/main.c)
target_sources(app PRIVATE src/shell.c)
target_sources(app PRIVATE src/sx1280.c)
target_sources(app PRIVATE src/work.c)
target_sources(app PRIVATE src/init.c)
```

## prj.conf
```kconfig
# Enable shell
CONFIG_SHELL=y
CONFIG_SHELL_BACKEND_SERIAL=y

# Enable logging
CONFIG_LOG=y

# Leds
CONFIG_ROBO_LED=y

CONFIG_SPI=y
CONFIG_GPIO=y
```

## app.overlay
```dts
//https://docs.zephyrproject.org/latest/build/dts/zephyr-user-node.html

#include <zephyr/dt-bindings/gpio/gpio.h>

/ {
     zephyr,user {
             signal-gpios = <&gpioa 1 GPIO_ACTIVE_HIGH>; 
     };
};
```

## src/main.c
```c
#include <zephyr/kernel.h>
#include <zephyr/logging/log.h>
#include <zephyr/drivers/gpio.h>

#include "init.h"
#include "work.h"
#include "roboime/robo_led.h"

LOG_MODULE_REGISTER(main, LOG_LEVEL_DBG);

#define ZEPHYR_USER_NODE DT_PATH(zephyr_user)

const struct gpio_dt_spec signal = GPIO_DT_SPEC_GET(ZEPHYR_USER_NODE, pa5_gpios);

void main(void)
{
    LOG_INF("SSL Robot Firmware Starting...");
    
    // Initialize modules
    init();

    // Initialize work queue and threads
    work_init();

    // Simple how to deal with gpio
    gpio_pin_configure_dt(&signal, GPIO_OUTPUT_INACTIVE);
    gpio_pin_set_dt(&signal, 1);

    // Main loop
    while (1) {
        LOG_INF("Alive");
        LOG_DBG("Debug message test");
        LOG_ERR("Error message test");
        robo_led_toggle(LED_YELLOW);
        robo_led_on(LED_GREEN);
        k_sleep(K_MSEC(1000));
    }
}
```

## src/init.c
```c
#include <zephyr/kernel.h>
#include <zephyr/drivers/gpio.h>
#include <zephyr/drivers/spi.h>
#include <zephyr/logging/log.h>

#include "roboime/robo_led.h"
#include "init.h"
#include "sx1280.h"

LOG_MODULE_REGISTER(init, LOG_LEVEL_DBG);
/* 
#define SX1280_TX_NODE DT_NODELABEL(sx1280_tx)
#define SX1280_RX_NODE DT_NODELABEL(sx1280_rx)

const struct device *spi_dev_tx = DEVICE_DT_GET(DT_BUS(SX1280_TX_NODE));
const struct device *spi_dev_rx = DEVICE_DT_GET(DT_BUS(SX1280_RX_NODE));

// CS GPIO specifications
static const struct gpio_dt_spec cs_gpio_tx = GPIO_DT_SPEC_GET(SX1280_TX_NODE, cs_gpios);
static const struct gpio_dt_spec cs_gpio_rx = GPIO_DT_SPEC_GET(SX1280_RX_NODE, cs_gpios); */

void init(void)
{
    // Initialize LEDS
    int ret;
    
    ret = robo_led_init();
    if (ret < 0) {
        LOG_ERR("Failed to initialize LEDs\n");
        return;
    }
  /*   // Initialize SPI for SX1280
    if (!device_is_ready(spi_dev_tx) || !device_is_ready(spi_dev_rx)) {
        LOG_INF("SPI device not ready");
        return;
    }

    // Initialize CS GPIO
    if (!device_is_ready(cs_gpio_tx.port) || !device_is_ready(cs_gpio_rx.port)) {
        LOG_INF("CS GPIO device not ready");
        return;
    }
    gpio_pin_configure_dt(&cs_gpio_tx, GPIO_OUTPUT_INACTIVE);
    gpio_pin_configure_dt(&cs_gpio_rx, GPIO_OUTPUT_INACTIVE);

    // Initialize SX1280
    if (sx1280_init(spi_dev_tx, &cs_gpio_tx) != 0 || sx1280_init(spi_dev_rx, &cs_gpio_rx) != 0) {
        LOG_INF("Failed to initialize SX1280");
        return;
    }
*/
    LOG_INF("Modules initialized successfully"); 

}
```

## src/shell.c
```c
/* Zephyr includes */
#include <zephyr/kernel.h>
#include <zephyr/logging/log.h>
#include <zephyr/shell/shell.h>
#include <zephyr/device.h>
#include <zephyr/drivers/uart.h>

LOG_MODULE_REGISTER(shell, LOG_LEVEL_DBG);

static int cmd_hello(const struct shell *shell, size_t argc, char **argv)
{
    shell_print(shell, "Hello, %s!", (argc > 1) ? argv[1] : "world");
    return 0;
}

static int cmd_menu(const struct shell *shell, size_t argc, char **argv)
{
    shell_print(shell, "RoboIME Menu:" );
    shell_print(shell, "1. Option 1 - Print Hello");
    shell_print(shell, "2. Option 2 - Print Goodbye");
    shell_print(shell, "3. Exit");
    return 0;
}

static int cmd_option1(const struct shell *shell, size_t argc, char **argv)
{
    shell_print(shell, "You selected Option 1");
    shell_print(shell, "Type 'hello [name]' to print a greeting.");
    return 0;
}

static int cmd_option2(const struct shell *shell, size_t argc, char **argv)
{
    shell_print(shell, "You selected Option 2");
    shell_print(shell, "Goodbye!");
    return 0;
}

static int cmd_exit(const struct shell *shell, size_t argc, char **argv)
{
    shell_print(shell, "Exiting...");
    return 0;
}

// Register commands
SHELL_CMD_REGISTER(hello, NULL, "Prints a greeting message", cmd_hello);
SHELL_CMD_REGISTER(menu, NULL, "Displays the menu", cmd_menu);
SHELL_CMD_REGISTER(option1, NULL, "Select Option 1", cmd_option1);
SHELL_CMD_REGISTER(option2, NULL, "Select Option 2", cmd_option2);
SHELL_CMD_REGISTER(exit, NULL, "Exit the application", cmd_exit);
```

## src/sx1280.c
```c
#include <zephyr/kernel.h>
#include <zephyr/drivers/spi.h>
#include <zephyr/drivers/gpio.h>
#include "sx1280.h"
#include <zephyr/logging/log.h>

#define SX1280_RESET_PIN 11  // Adjust as needed

LOG_MODULE_REGISTER(antenna, LOG_LEVEL_DBG);

static const struct device *spi_device;
static const struct gpio_dt_spec *cs_gpio;
static struct gpio_dt_spec reset_gpio = GPIO_DT_SPEC_GET_OR(DT_NODELABEL(sx1280), reset_gpios, {0});

int sx1280_init(const struct device *spi_dev, const struct gpio_dt_spec *cs)
{
    spi_device = spi_dev;
    cs_gpio = cs;

    // Configure reset GPIO
    if (!device_is_ready(reset_gpio.port)) {
        LOG_INF("Reset GPIO device not ready");
        return -1;
    }
    gpio_pin_configure_dt(&reset_gpio, GPIO_OUTPUT_INACTIVE);

    // Reset SX1280
    gpio_pin_set_dt(&reset_gpio, 1);
    k_sleep(K_MSEC(10));
    gpio_pin_set_dt(&reset_gpio, 0);
    k_sleep(K_MSEC(10));

    // Initialize SX1280 registers here
    // This would involve sending SPI commands to configure the device
    // Example (pseudo-code):
    // sx1280_write_register(REG_OPERATING_MODE, MODE_LORA);
    // sx1280_write_register(REG_FREQUENCY, FREQ_915_MHZ);
    // ... (more configuration)

    return 0;
}

int sx1280_send(const uint8_t *data, size_t len)
{
    // Implement SX1280 send functionality
    // This would involve writing to the FIFO and triggering transmission
    return 0;
}

int sx1280_receive(uint8_t *data, size_t max_len)
{
    // Implement SX1280 receive functionality
    // This would involve reading from the FIFO when data is available
    return 0;
}
/* 
// Helper functions for SPI communication
static int sx1280_write_register(uint8_t reg, uint8_t value)
{
    uint8_t tx_data[2] = {reg | 0x80, value};  // Set write bit
    const struct spi_buf tx_buf = {.buf = tx_data, .len = sizeof(tx_data)};
    const struct spi_buf_set tx = {.buffers = &tx_buf, .count = 1};

    gpio_pin_set_dt(cs_gpio, 0);  // Assert CS
    int ret = spi_write(spi_device, &tx);
    gpio_pin_set_dt(cs_gpio, 1);  // Deassert CS

    return ret;
}

static int sx1280_read_register(uint8_t reg, uint8_t *value)
{
    uint8_t tx_data[2] = {reg & 0x7F, 0};  // Clear write bit
    uint8_t rx_data[2];
    const struct spi_buf tx_buf = {.buf = tx_data, .len = sizeof(tx_data)};
    const struct spi_buf rx_buf = {.buf = rx_data, .len = sizeof(rx_data)};
    const struct spi_buf_set tx = {.buffers = &tx_buf, .count = 1};
    const struct spi_buf_set rx = {.buffers = &rx_buf, .count = 1};

    gpio_pin_set_dt(cs_gpio, 0);  // Assert CS
    int ret = spi_transceive(spi_device, &tx, &rx);
    gpio_pin_set_dt(cs_gpio, 1);  // Deassert CS

    if (ret == 0) {
        *value = rx_data[1];
    }

    return ret;
}
 */
```

## src/sx1280.h
```c
#ifndef SX1280_H
#define SX1280_H

#include <zephyr/drivers/spi.h>
#include <zephyr/drivers/gpio.h>

int sx1280_init(const struct device *spi_dev, const struct gpio_dt_spec *cs_gpio);
int sx1280_send(const uint8_t *data, size_t len);
int sx1280_receive(uint8_t *data, size_t max_len);

#endif /* SX1280_H */
```

## src/work.c
```c
#include <zephyr/kernel.h>
#include <zephyr/drivers/gpio.h>
#include <zephyr/logging/log.h>

#include "work.h"

LOG_MODULE_REGISTER(work, LOG_LEVEL_DBG);

#define STACK_SIZE 1024
#define THREAD_PRIORITY 5

K_THREAD_STACK_DEFINE(motor_stack, STACK_SIZE);
K_THREAD_STACK_DEFINE(communication_stack, STACK_SIZE);

struct k_thread motor_thread;
struct k_thread communication_thread;

struct k_work_delayable motor_work;
struct k_work_delayable communication_work;

static void motor_work_handler(struct k_work *work)
{
    // Handle motor control
    LOG_INF("Motor control");
    k_work_schedule(&motor_work, K_MSEC(1000));
}

static void communication_work_handler(struct k_work *work)
{
    // Handle SX1280 communication
    LOG_INF("SX1280 communication");
    k_work_schedule(&communication_work, K_MSEC(5000));
}

static void motor_thread_entry(void *p1, void *p2, void *p3)
{
    k_work_init_delayable(&motor_work, motor_work_handler);
    k_work_schedule(&motor_work, K_NO_WAIT);

    while (1) {
        k_sleep(K_FOREVER);
    }
}

static void communication_thread_entry(void *p1, void *p2, void *p3)
{
    k_work_init_delayable(&communication_work, communication_work_handler);
    k_work_schedule(&communication_work, K_NO_WAIT);

    while (1) {
        k_sleep(K_FOREVER);
    }
}

void work_init(void)
{
    k_thread_create(&motor_thread, motor_stack, STACK_SIZE,
                    motor_thread_entry, NULL, NULL, NULL,
                    THREAD_PRIORITY, 0, K_NO_WAIT);

    k_thread_create(&communication_thread, communication_stack, STACK_SIZE,
                    communication_thread_entry, NULL, NULL, NULL,
                    THREAD_PRIORITY, 0, K_NO_WAIT);
}
```

## src/work.h
```c
#ifndef WORK_H
#define WORK_H

void work_init(void);

#endif /* WORK_H */
```
