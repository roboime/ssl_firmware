## CMakeLists.txt
```
# SPDX-License-Identifier: Apache-2.0

cmake_minimum_required(VERSION 3.20.0)
find_package(Zephyr REQUIRED HINTS $ENV{ZEPHYR_BASE})

project(nexus)

target_sources(app PRIVATE src/main.c)
target_sources(app PRIVATE src/shell.c)
target_sources(app PRIVATE src/work.c)
target_sources(app PRIVATE src/init.c)
```

## prj.conf
```kconfig
# Enable shell
CONFIG_SHELL=y
CONFIG_SHELL_BACKEND_SERIAL=y

# Enable logging
CONFIG_LOG=y

# Leds
CONFIG_ROBO_LED=y

CONFIG_SPI=y
CONFIG_GPIO=y
```

## src/init.h
```c
#ifndef INIT_H
#define INIT_H

void init(void);

#endif /* INIT_H */
```

## src/shell.c
```c
/* Zephyr includes */
#include <zephyr/kernel.h>
#include <zephyr/logging/log.h>
#include <zephyr/shell/shell.h>
#include <zephyr/device.h>
#include <zephyr/drivers/uart.h>

LOG_MODULE_REGISTER(shell, LOG_LEVEL_DBG);

static int cmd_hello(const struct shell *shell, size_t argc, char **argv)
{
    shell_print(shell, "Hello, %s!", (argc > 1) ? argv[1] : "world");
    return 0;
}

static int cmd_menu(const struct shell *shell, size_t argc, char **argv)
{
    /* Use ANSI escape codes for colored text */
    shell_print(shell, "\033[1;34m==== RoboIME Menu ====\033[0m");
    shell_print(shell, "\033[1;32m1. Option 1 - Print Hello\033[0m");
    shell_print(shell, "\033[1;33m2. Option 2 - Print Goodbye\033[0m");
    shell_print(shell, "\033[1;31m3. Exit\033[0m");
    return 0;
}

static int cmd_option1(const struct shell *shell, size_t argc, char **argv)
{
    shell_print(shell, "You selected Option 1");
    shell_print(shell, "Type 'hello [name]' to print a greeting.");
    return 0;
}

static int cmd_option2(const struct shell *shell, size_t argc, char **argv)
{
    shell_print(shell, "You selected Option 2");
    shell_print(shell, "Goodbye!");
    return 0;
}

static int cmd_exit(const struct shell *shell, size_t argc, char **argv)
{
    shell_print(shell, "Exiting...");
    return 0;
}

/* Register commands */
SHELL_CMD_REGISTER(hello, NULL, "Prints a greeting message", cmd_hello);
SHELL_CMD_REGISTER(menu, NULL, "Displays the menu", cmd_menu);
SHELL_CMD_REGISTER(option1, NULL, "Select Option 1", cmd_option1);
SHELL_CMD_REGISTER(option2, NULL, "Select Option 2", cmd_option2);
SHELL_CMD_REGISTER(exit, NULL, "Exit the application", cmd_exit);
```

## src/work.c
```c
#include <zephyr/kernel.h>
#include <zephyr/drivers/gpio.h>
#include <zephyr/logging/log.h>

#include "work.h"

LOG_MODULE_REGISTER(work, LOG_LEVEL_DBG);

#define STACK_SIZE 1024
#define THREAD_PRIORITY 5

K_THREAD_STACK_DEFINE(motor_stack, STACK_SIZE);
K_THREAD_STACK_DEFINE(communication_stack, STACK_SIZE);

struct k_thread motor_thread;
struct k_thread communication_thread;

struct k_work_delayable motor_work;
struct k_work_delayable communication_work;

static void motor_work_handler(struct k_work *work)
{
    // Handle motor control
    LOG_INF("Motor control");
    k_work_schedule(&motor_work, K_MSEC(1000));
}

static void communication_work_handler(struct k_work *work)
{
    // Handle SX1280 communication
    LOG_INF("SX1280 communication");
    k_work_schedule(&communication_work, K_MSEC(5000));
}

static void motor_thread_entry(void *p1, void *p2, void *p3)
{
    k_work_init_delayable(&motor_work, motor_work_handler);
    k_work_schedule(&motor_work, K_NO_WAIT);

    while (1) {
        k_sleep(K_FOREVER);
    }
}

static void communication_thread_entry(void *p1, void *p2, void *p3)
{
    k_work_init_delayable(&communication_work, communication_work_handler);
    k_work_schedule(&communication_work, K_NO_WAIT);

    while (1) {
        k_sleep(K_FOREVER);
    }
}

void work_init(void)
{
    LOG_DBG("Debug message test");
    k_thread_create(&motor_thread, motor_stack, STACK_SIZE,
                    motor_thread_entry, NULL, NULL, NULL,
                    THREAD_PRIORITY, 0, K_NO_WAIT);

    k_thread_create(&communication_thread, communication_stack, STACK_SIZE,
                    communication_thread_entry, NULL, NULL, NULL,
                    THREAD_PRIORITY, 0, K_NO_WAIT);
}
```
