## applications/blinky/build/Kconfig/arch/Kconfig
```kconfig
# Load arch Kconfig descriptions.
osource "/home/frese/personal_projects/roboime_firmware/zephyr/arch/x86/Kconfig"
osource "/home/frese/personal_projects/roboime_firmware/zephyr/arch/xtensa/Kconfig"
osource "/home/frese/personal_projects/roboime_firmware/zephyr/arch/sparc/Kconfig"
osource "/home/frese/personal_projects/roboime_firmware/zephyr/arch/riscv/Kconfig"
osource "/home/frese/personal_projects/roboime_firmware/zephyr/arch/posix/Kconfig"
osource "/home/frese/personal_projects/roboime_firmware/zephyr/arch/nios2/Kconfig"
osource "/home/frese/personal_projects/roboime_firmware/zephyr/arch/mips/Kconfig"
osource "/home/frese/personal_projects/roboime_firmware/zephyr/arch/arm64/Kconfig"
osource "/home/frese/personal_projects/roboime_firmware/zephyr/arch/arm/Kconfig"
osource "/home/frese/personal_projects/roboime_firmware/zephyr/arch/arc/Kconfig"
```

## boards/st/nucleo_h723zg/board.yml
```yaml
board:
  name: roboime_nucleo_h723zg
  vendor: st
  socs:
    - name: stm32h723xx
```

## subsys/Kconfig
```kconfig
#
# Copyright (c) 2023 HARDWARIO a.s.
#
# SPDX-License-Identifier: LicenseRef-HARDWARIO-5-Clause
#

menu "Subsystems"

rsource "robo_led/Kconfig"

endmenu
```

## subsys/robo_led/Kconfig
```kconfig
menuconfig ROBO_LED
    bool "ROBO_LED"
    select LED

if ROBO_LED

endif # ROBO_LED
```

## west.yml
```yaml
manifest:
  remotes:
    - name: zephyrproject-rtos
      url-base: https://github.com/zephyrproject-rtos
    - name: roboime
      url-base: https://github.com/roboime
  projects:
    - name: zephyr
      remote: zephyrproject-rtos
      revision: main
      import: true
      west-commands: scripts/west-commands.yml
self:
  path: ssl_firmware
  west-commands: ssl_firmware/scripts/west-commands.yml
```
